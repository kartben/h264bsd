## zephyr/Kconfig
```kconfig
# Copyright (c) 2026 Benjamin Cabé
# SPDX-License-Identifier: Apache-2.0

menuconfig H264BSD
	bool "h264bsd H.264 baseline profile decoder"
	depends on ZEPHYR_H264BSD_MODULE
	help
	  Decode H.264 baseline profile video in software. On an Armv8.1-M
	  core with Helium the filters and interpolators are vectorised
	  automatically; everywhere else the plain C is built.

if H264BSD

config H264BSD_MALLOC
	string "Name of the function the decoder allocates through"
	default "malloc"
	help
	  The decoder allocates its reference pictures once, when the stream
	  dimensions become known, and they are large: a megabyte or so at
	  800x480. Name a function of your own here to place them somewhere
	  other than the libc heap.

config H264BSD_PICTURE_MALLOC
	string "Name of the function the decoder allocates pictures through"
	default "malloc"
	help
	  The decoded pictures dwarf everything else the decoder holds, and a
	  part whose fast memory cannot take them can still keep the rest of
	  the decoder's state there. Name a function of your own to place the
	  pictures on their own; the default sends them wherever
	  H264BSD_MALLOC sends the rest.

config H264BSD_PICTURE_FREE
	string "Name of the function the decoder releases pictures through"
	default "free"
	help
	  Releases what H264BSD_PICTURE_MALLOC returned.

config H264BSD_FREE
	string "Name of the function the decoder releases memory through"
	default "free"
	help
	  Releases what H264BSD_MALLOC returned.

config H264BSD_DEBLOCK_THREAD
	bool "Deblock on another CPU"
	depends on SMP && SCHED_CPU_MASK
	help
	  Filter the decoded macroblocks on a thread pinned to another CPU,
	  a row at a time behind the decoding, instead of between rows on the
	  decoding thread. A picture is complete once its last rows have been
	  filtered, which the decoder waits for.

if H264BSD_DEBLOCK_THREAD

config H264BSD_DEBLOCK_THREAD_CPU
	int "CPU the deblocking thread runs on"
	default 1
	help
	  Pick one the decoding thread does not run on.

config H264BSD_DEBLOCK_THREAD_PRIORITY
	int "Deblocking thread priority"
	default 2
	help
	  The decoder waits for the last rows of every picture, so the thread
	  should not be kept waiting by others on its CPU.

config H264BSD_DEBLOCK_THREAD_STACK_SIZE
	int "Deblocking thread stack size"
	default 2048

endif # H264BSD_DEBLOCK_THREAD

endif # H264BSD
```
